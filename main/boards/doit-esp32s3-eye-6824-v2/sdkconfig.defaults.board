## main/boards/doit-esp32s3-eye-6824-v2/sdkconfig.defaults.board
```kconfig
CONFIG_BOARD_TYPE_DOIT_ESP32S3_EYE_6824_V2=y

CONFIG_DOIT_DISPLAY_LCD_TYPE=LCD_ST7796_240X240
CONFIG_USE_AUDIO_CODEC_ENCODE_OPUS=y
CONFIG_VB6824_OTA_SUPPORT=y
CONFIG_USE_AFE_WAKE_WORD=n
CONFIG_USE_WAKE_WORD_DETECT=n
CONFIG_USE_AUDIO_PROCESSOR=n
CONFIG_USE_AUDIO_PROCESSOR=n

CONFIG_ESP_WIFI_NVS_ENABLED=n
CONFIG_BT_ENABLED=y
CONFIG_BT_NIMBLE_ENABLED=y
CONFIG_BT_NIMBLE_BLUFI_ENABLE=y
CONFIG_BT_CTRL_RUN_IN_FLASH_ONLY=y
```
