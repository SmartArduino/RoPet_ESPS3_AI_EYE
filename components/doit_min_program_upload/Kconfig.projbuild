## components/doit_min_program_upload/Kconfig.projbuild
```kconfig
menu "MIN_PROGRAM_PSD_Configuration"
    config SUPPORT_MINI_PROGRAMS_REPLACE_PSD
        bool "支持小程序素材替换（VPG动画眼睛）"
        depends on IDF_TARGET_ESP32S3
        help 
            支持小程序素材替换（VPG动画眼睛）

    choice
        prompt "选择素材存储数量"
            default USE_PSD_ONE
        depends on SUPPORT_MINI_PROGRAMS_REPLACE_PSD
        help
            选择素材存在方式
    config USE_PSD_ONE
        bool "只存一个素材"
        default y
        depends on SUPPORT_MINI_PROGRAMS_REPLACE_PSD
        help
            只存一个素材
    config USE_PSD_MULTIPLE
        bool "存多个素材"
        default n
        depends on SUPPORT_MINI_PROGRAMS_REPLACE_PSD
        help
            存多个素材
    endchoice

    config USE_PSD_ONE_FILE_NAME
        string "flash中唯一素材的文件名"
        depends on USE_PSD_ONE
        default "vpg_first"
        help
            设置 Flash 中唯一素材的文件名。

    config USE_PSD_MULTIPLE_NUM
        int "flash中同时存在的素材数量"
        depends on USE_PSD_MULTIPLE
        default 2
        range 2 4
        help
            设置 Flash 中同时缓存的 PSD 素材最大个数。

    config USE_PSD_MULTIPLE_FILE_FIRST
        string "素材文件名 #1"
        default "vpg_first"
        depends on USE_PSD_MULTIPLE_NUM >= 2
        help
            第 1 个 PSD 文件名称（含扩展名）。

    config USE_PSD_MULTIPLE_FILE_SECOND
        string "素材文件名 #2"
        default "vpg_second"
        depends on USE_PSD_MULTIPLE_NUM >= 2

    config USE_PSD_MULTIPLE_FILE_THIRD
        string "素材文件名 #3"
        default "vpg_third"
        depends on USE_PSD_MULTIPLE_NUM >= 3

    config USE_PSD_MULTIPLE_FILE_FOURTH
        string "素材文件名 #4"
        default "vpg_fourth"
        depends on USE_PSD_MULTIPLE_NUM >= 4

endmenu
```

## components/dot_fs_fat/Kconfig.projbuild
```kconfig
menu "DOT_FS_FAT_CONFIG"
    config FILE_BASE_PATH
        string "Flash中素材文件的基础路径"
        default "/psd"
        help
            设置 Flash 中素材文件的基础路径。
endmenu
```

## main/boards/doit-esp32s3-eye-6824/sdkconfig.defaults.board
```kconfig
CONFIG_BOARD_TYPE_DOIT_ESP32S3_EYE_6824=y

CONFIG_DISPLAY_LCD_TYPE=LCD_GC9A01_160X160
CONFIG_USE_EYE_STYLE_VB6824=y
CONFIG_USE_AUDIO_CODEC_ENCODE_OPUS=y
CONFIG_VB6824_OTA_SUPPORT=y
CONFIG_USE_AFE_WAKE_WORD=n
CONFIG_USE_WAKE_WORD_DETECT=n
CONFIG_USE_AUDIO_PROCESSOR=n
CONFIG_USE_AUDIO_PROCESSOR=n
```

## sdkconfig.defaults
```kconfig
CONFIG_COMPILER_CXX_EXCEPTIONS=y
CONFIG_COMPILER_CXX_EXCEPTIONS_EMG_POOL_SIZE=1024

CONFIG_BOOTLOADER_COMPILER_OPTIMIZATION_PERF=y
CONFIG_BOOTLOADER_LOG_LEVEL_NONE=y
CONFIG_BOOTLOADER_SKIP_VALIDATE_ALWAYS=y
CONFIG_BOOTLOADER_APP_ROLLBACK_ENABLE=y

CONFIG_HTTPD_MAX_REQ_HDR_LEN=2048
CONFIG_HTTPD_MAX_URI_LEN=2048

CONFIG_PARTITION_TABLE_CUSTOM=y
CONFIG_PARTITION_TABLE_CUSTOM_FILENAME="partitions/v1/16m.csv"
CONFIG_PARTITION_TABLE_OFFSET=0x8000

CONFIG_ESP_TASK_WDT_TIMEOUT_S=10
CONFIG_FREERTOS_GENERATE_RUN_TIME_STATS=y
CONFIG_FREERTOS_USE_STATS_FORMATTING_FUNCTIONS=y

CONFIG_ESP_MAIN_TASK_STACK_SIZE=8192
CONFIG_MBEDTLS_DYNAMIC_BUFFER=y
CONFIG_MBEDTLS_SSL_KEEP_PEER_CERTIFICATE=n
CONFIG_ESP_WIFI_IRAM_OPT=n
CONFIG_ESP_WIFI_RX_IRAM_OPT=n
CONFIG_ESP_WIFI_DYNAMIC_RX_MGMT_BUFFER=y

# These entries are copied from ESP-HI (ESP32C3) to reduce memory usage
CONFIG_ESP_WIFI_STATIC_RX_BUFFER_NUM=6
CONFIG_ESP_WIFI_DYNAMIC_RX_BUFFER_NUM=8
CONFIG_NEWLIB_NANO_FORMAT=y
CONFIG_ESP_WIFI_ENTERPRISE_SUPPORT=n

CONFIG_CODEC_I2C_BACKWARD_COMPATIBLE=n

# Fix ML307 FIFO Overflow
CONFIG_UART_ISR_IN_IRAM=y

# LVGL 9.2.2

CONFIG_LV_OS_NONE=y
CONFIG_LV_USE_OS=0
CONFIG_LV_USE_CLIB_MALLOC=y
CONFIG_LV_USE_CLIB_STRING=y
CONFIG_LV_USE_CLIB_SPRINTF=y
CONFIG_LV_USE_IMGFONT=y

# Use compressed font
CONFIG_LV_FONT_FMT_TXT_LARGE=y
CONFIG_LV_USE_FONT_COMPRESSED=y
CONFIG_LV_USE_FONT_PLACEHOLDER=y

# Disable extra widgets to save flash size
CONFIG_LV_USE_ANIMIMG=n
CONFIG_LV_USE_CALENDAR=n
CONFIG_LV_USE_CALENDAR_HEADER_ARROW=n
CONFIG_LV_USE_CALENDAR_HEADER_DROPDOWN=n
CONFIG_LV_USE_CHART=n
CONFIG_LV_USE_KEYBOARD=n
CONFIG_LV_USE_LED=n
CONFIG_LV_USE_LIST=n
CONFIG_LV_USE_MENU=n
CONFIG_LV_USE_MSGBOX=n
CONFIG_LV_USE_SPAN=n
CONFIG_LV_USE_SPINBOX=n
CONFIG_LV_USE_SPINNER=n
CONFIG_LV_USE_TABVIEW=n
CONFIG_LV_USE_TILEVIEW=n
CONFIG_LV_USE_WIN=n

CONFIG_LV_BUILD_EXAMPLES=n

CONFIG_COMPILER_OPTIMIZATION_SIZE=y

CONFIG_FREERTOS_HZ=1000


CONFIG_SPEAKING_FIRST_MUTE_TIME=60
CONFIG_PARTITION_TABLE_CUSTOM=y
CONFIG_PARTITION_TABLE_CUSTOM_FILENAME="components/doit_min_program_upload/16m_min_programe_psd.csv"
CONFIG_PARTITION_TABLE_FILENAME="components/doit_min_program_upload/16m_min_programe_psd.csv"
CONFIG_PARTITION_TABLE_OFFSET=0x8000

CONFIG_SUPPORT_MINI_PROGRAMS_REPLACE_PSD=y
CONFIG_USE_PSD_MULTIPLE=y
CONFIG_USE_PSD_MULTIPLE_NUM=3

CONFIG_USE_ESP_WAKE_WORD=n
CONFIG_USE_AFE_WAKE_WORD=n
CONFIG_USE_AUDIO_PROCESSOR=n
CONFIG_USE_AUDIO_DEBUGGER=n

CONFIG_USE_BLUFI_NET_CONFIGURING=y

# blufi support, need enable USE_BLUFI_NET_CONFIGURING
CONFIG_MBEDTLS_DHM_C=y
CONFIG_MBEDTLS_HARDWARE_MPI=n
CONFIG_BT_GATTC_ENABLE=n
CONFIG_BT_BLE_SMP_ENABLE=n
CONFIG_BT_NIMBLE_ENABLED=y
CONFIG_BT_NIMBLE_GAP_SERVICE=y
CONFIG_BT_NIMBLE_ROLE_CENTRAL=n
CONFIG_BT_NIMBLE_ROLE_OBSERVER=n
CONFIG_BT_NIMBLE_50_FEATURE_SUPPORT=n
CONFIG_BT_NIMBLE_SECURITY_ENABLE=n
CONFIG_BT_NIMBLE_CRYPTO_STACK_MBEDTLS=n
CONFIG_BT_NIMBLE_BLUFI_ENABLE=y
CONFIG_BT_CTRL_RUN_IN_FLASH_ONLY=y
CONFIG_BT_NIMBLE_ROLE_PERIPHERAL=y
CONFIG_BT_NIMBLE_ROLE_BROADCASTER=n
CONFIG_BT_NIMBLE_MAX_CONNECTIONS=1
CONFIG_BT_NIMBLE_ATT_PREFERRED_MTU=256
CONFIG_IPC_TASK_STACK_SIZE=1024
CONFIG_MQTT_USE_CUSTOM_CONFIG=y
CONFIG_MQTT_TASK_STACK_SIZE=3072
CONFIG_TCPIP_TASK_STACK_SIZE=2048
CONFIG_PTHREAD_TASK_STACK_SIZE_DEFAULT=3072

CONFIG_MDNS_MEMORY_ALLOC_SPIRAM=y
CONFIG_ESP32S3_DATA_CACHE_32KB=y
CONFIG_ESP32S3_DATA_CACHE_SIZE=0x8000
CONFIG_SPIRAM_XIP_FROM_PSRAM=y
CONFIG_SPIRAM_FETCH_INSTRUCTIONS=y
CONFIG_SPIRAM_RODATA=y
CONFIG_MBEDTLS_EXTERNAL_MEM_ALLOC=y
```
